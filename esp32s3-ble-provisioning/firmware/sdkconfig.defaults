## esp32s3-ble-provisioning/firmware/sdkconfig.defaults
```kconfig
CONFIG_ESPTOOLPY_FLASHSIZE_8MB=y
CONFIG_BT_ENABLED=y
CONFIG_BT_BLE_ENABLED=y
CONFIG_WIFI_PROV_BLE=y
CONFIG_ESP_WIFI_SOFTAP_SUPPORT=y
```
